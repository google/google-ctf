## 2026/hackceler8/replayer/firmware/boards/google/hackceler8-2026-replayer/Kconfig.defconfig
```kconfig
# Copyright (c) 2026 Google LLC
# SPDX-License-Identifier: Apache-2.0

if BOARD_HACKCELER8_2026_REPLAYER

config USB_SELF_POWERED
	default n

endif # BOARD_HACKCELER8_2026_REPLAYER
```

## 2026/hackceler8/replayer/firmware/boards/google/hackceler8-2026-replayer/Kconfig.hackceler8-2026-replayer
```kconfig
# Copyright (c) 2026 Google LLC
# SPDX-License-Identifier: Apache-2.0

config BOARD_HACKCELER8_2026_REPLAYER
	select SOC_RP2350B_M33 if BOARD_HACKCELER8_2026_REPLAYER_RP2350B_M33
```

## 2026/hackceler8/replayer/firmware/boards/google/hackceler8-2026-replayer/board.yml
```yaml
board:
  name: hackceler8-2026-replayer
  full_name: Hackceler8 2026 Replayer
  vendor: google
  socs:
    - name: rp2350b
```

## 2026/hackceler8/replayer/firmware/boards/google/hackceler8-2026-replayer/hackceler8-2026-replayer_rp2350b_m33_defconfig
```kconfig
CONFIG_BUILD_OUTPUT_HEX=y
CONFIG_BUILD_OUTPUT_UF2=y
CONFIG_CLOCK_CONTROL=y
CONFIG_GPIO=y
CONFIG_RESET=y
CONFIG_USE_DT_CODE_PARTITION=y
```
